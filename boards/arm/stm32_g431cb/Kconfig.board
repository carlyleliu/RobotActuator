## boards/arm/stm32_g431cb/Kconfig.board
```kconfig
# STM32G431RB Nucleo board configuration

# Copyright (c) 2019 Richard Osterloh <richard.osterloh@gmail.com>
# SPDX-License-Identifier: Apache-2.0

config BOARD_G431CB
	bool "STM32 G431CB Development Board"
	depends on SOC_STM32G431XX
```

## drivers/zephyr/sensor/tle5012b/Kconfig
```kconfig
# TLE5012B Six-Axis Motion Tracking device configuration options
#
# Copyright (c) 2022 Esco Medical ApS
# Copyright (c) 2020 TDK Invensense
#
# SPDX-License-Identifier: Apache-2.0

DT_COMPAT_TLE5012B := invensense,tle5012b

menuconfig TLE5012B
	bool "TLE5012B Six-Axis Motion Tracking Device"
	default $(dt_compat_enabled,$(DT_COMPAT_TLE5012B))
	depends on SPI
	help
	  Enable driver for TLE5012B SPI-based six-axis motion tracking device.
```

## dts/bindings/sensor/infineon,gmr.yaml
```yaml
# Copyright (c) 2022 Esco Medical ApS
# Copyright (c) 2020 Infineon Invensense
# SPDX-License-Identifier: Apache-2.0

description: Infineon iGMR device

compatible: "infineon,gmr"

include: spi-device.yaml

properties:
    int-gpios:
      type: phandle-array
      description: |
        The INT signal default configuration is active-high. The
        property value should ensure the flags properly describe the
        signal that is presented to the driver.
    resolution:
      type: int
      description: |
        The INT signal default configuration is active-high. The
        property value should ensure the flags properly describe the
        signal that is presented to the driver.
      enum:
        - 12
        - 14
        - 15
        - 16
```

## dts/bindings/servo-pwms.yaml
```yaml
# Copyright (c) 2022 Nordic Semiconductor ASA
# SPDX-License-Identifier: Apache-2.0

description: PWM-driven servo motor.

compatible: "pwms-spec"

include: base.yaml

child-binding:
    description: pwm for servo
    properties:
      pwms:
        required: true
        type: phandle-array
        description: PWM specifier driving the servo motor.
      pwm-names:
        required: true
        type: string-array
        description: PWM driving name for the servo motor.
```
